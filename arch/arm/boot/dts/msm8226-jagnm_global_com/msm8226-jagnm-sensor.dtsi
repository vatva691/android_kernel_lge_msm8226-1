/* Copyright (c) 2012, Code Aurora Forum. All rights reserved.
 *
 * This program is free software; you can redistribute it and/or modify
 * it under the terms of the GNU General Public License version 2 and
 * only version 2 as published by the Free Software Foundation.
 *
 * This program is distributed in the hope that it will be useful,
 * but WITHOUT ANY WARRANTY; without even the implied warranty of
 * MERCHANTABILITY or FITNESS FOR A PARTICULAR PURPOSE.  See the
 * GNU General Public License for more details.
 */

&i2c_2 {
        bma2x2@11 {
                compatible = "bosch,bma2x2";
                reg = <0x11>;
                vdd-supply = <&pm8226_l19>;
                gpios = <&msmgpio 69 0>; /* IRQ */
                bma,place = <7>;
        };

        bmm050@13 {
                compatible = "bosch,bmm050";
                reg = <0x13>;
                vdd-supply = <&pm8226_l19>;
                gpios = <&msmgpio 66 0>; /* IRQ */
                bmm,place = <4>;
        };
};

